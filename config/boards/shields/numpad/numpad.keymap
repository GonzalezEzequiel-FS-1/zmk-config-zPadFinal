#include <behaviors.dtsi>
#include <dt-bindings/zmk/keys.h>
#include <dt-bindings/zmk/bt.h>

&numpad {
    keymap {
        compatible = "zmk,keymap";

        default_layer {
            bindings = <
                &kp KP_NUMLOCK  &kp KP_SLASH    &kp KP_ASTERISK &kp KP_MINUS
                &none           &kp KP_NUMBER_9 &kp KP_NUMBER_8 &kp KP_NUMBER_7
                &kp KP_PLUS     &kp KP_NUMBER_6 &kp KP_NUMBER_5 &kp KP_NUMBER_4
                &none           &kp KP_NUMBER_3 &kp KP_NUMBER_2 &kp KP_NUMBER_1
                &kp KP_ENTER    &none           &kp KP_DOT      &kp KP_NUMBER_0
            >;
        };
    };
};
